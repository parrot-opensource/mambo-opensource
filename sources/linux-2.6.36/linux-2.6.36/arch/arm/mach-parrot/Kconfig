## sources/linux-2.6.36/linux-2.6.36/arch/arm/mach-parrot/Kconfig
```kconfig
menu "Parrot5 machines"
	depends on ARCH_PARROT5

config MACH_PARROT_P5
	bool "Support Parrot5/5+ platform"
	default y
	help
	  Include support for the Parrot5/5+ platform.

config MACH_CK5050P
	bool "Support ck5050p platform"
	default y
	help
	  Include support for the CK5050P(P5+) platform.


endmenu
```

## sources/linux-2.6.36/linux-2.6.36/drivers/parrot/char/Kconfig
```kconfig
config PARROT_DMAMEM
	tristate "dmamem"
	depends on  ARCH_PARROT6

config PARROT_GPIO
	tristate "gpio"
	help
		Allow userspace to drive gpio

config PARROT_PWM
	tristate "pwm"
	help
		Allow userspace to drive pwm
```

## sources/linux-2.6.36/linux-2.6.36/drivers/parrot/i2c/Kconfig
```kconfig
config I2CM_PARROT
    tristate "PARROT I2C master driver"
	depends on ARM && (ARCH_PARROT || ARCH_PARROT6 || VERSATILE_PARROT6)
	select I2C
	help
        Select Parrot I2C master driver.

config RTC_DRV_P6MU
	tristate "P6MU rtc"
	depends on ARCH_AT91RM9200 || ARCH_AT91SAM9RL || ARCH_PARROT
	depends on RTC_CLASS
	depends on I2CM_PARROT
	select RTC_DRV_AT91RM9200
	help
	  Driver for the internal RTC (Realtime Clock) module found on
	  P6MU.

config PARROT_SMSC_USB82514_USB_HUB
	bool "SMSC USB82514 USB HUB"
	depends on I2C
	help
		Automotive Grade USB 2.0 Hi-Speed 4-Port Hub
```

## sources/linux-2.6.36/linux-2.6.36/drivers/parrot/input/Kconfig
```kconfig
config KBD_PARROT6
	tristate "PARROT6 Keyboard / Trackball support"
	depends on  ARCH_PARROT6 && INPUT

 ---help---

config KBD_PARROT6_DEBUG
	bool "debug"
	depends on KBD_PARROT6

config RNB4_ROTATOR
	tristate "Rnb4 rotator support"
	select ARCH_PARROT_USE_ROTATOR
	depends on  ARCH_PARROT6 && INPUT


config P5_I2CS_INPUT
	tristate "PARROT5 i2cs input"
	depends on  ARCH_PARROT6 && INPUT

 ---help---
```

## sources/linux-2.6.36/linux-2.6.36/drivers/parrot/jpsumo_adc/Kconfig
```kconfig
config JPSUMO_ADC
	tristate "Parrot Jumping Sumo ADC driver"
	depends on MACH_PARROT_JPSUMO || MACH_PARROT_JPSUMO_EVO || MACH_PARROT_JPSUMO3
	select AAI_IRQ_SHARED
	default n
	help
		Select Parrot6i AAI ADC driver with features specific to the
		Jumping Sumo.
```

## sources/linux-2.6.36/linux-2.6.36/drivers/parrot/misc/Kconfig
```kconfig
config DYNAMIC_PINMUX
	depends on ARCH_PARROT6
	tristate "Dynamic pinmux"
	default n
```

## sources/linux-2.6.36/linux-2.6.36/drivers/parrot/net/wireless/88w8688/bt/Kconfig
```kconfig
config 88W8688_BT
	tristate "88W8688 Bluetooth driver"
	depends on BT && 88W8688
	help
		Bluetooth 3.0 support

config 88W8688_BT_DEBUG
	bool "88W8688 debugging"
	depends on 88W8688_BT != n
	default n
	help
	  This is an option for use by developers; most people should
	  say N here.  This enables driver debugging.
```

## sources/linux-2.6.36/linux-2.6.36/drivers/parrot/pressure/Kconfig
```kconfig
#
# Pressure drivers
#
# When adding new entries keep the list in alphabetical order

menu "ST Pressure sensors"

config PARROT_ST22HB
	tristate "ST 22 HB pressure sensor driver"
	depends on I2C && SYSFS
	help
	  Say yes here to build support for the ST22HB
	  pressure sensor connected via I2C.

config PARROT_ST22HB_USE_THREADED_INTERRUPTS
	bool "Use threaded interrupts to trigger i2c readings"
        depends on PARROT_ST22HB
	default y
	help
	  Use threaded interrupts to trigger i2c readings.
	  Say no here if you want to use delayed workqueues as implemented in
	  the original driver.
endmenu
```

## sources/linux-2.6.36/linux-2.6.36/drivers/parrot/serial/Kconfig
```kconfig
config SERIAL_PARROT5
	bool "Parrot5/5+ serial port support"
	depends on ARM && ARCH_PARROT
	select SERIAL_CORE
	help
	  If you have a board based on Parrot5/5+ SoC you
	  can enable its onboard serial port by enabling this option.

          To compile this driver as a module, choose M here: the
          module will be called parrot5-serial.

config SERIAL_PARROT5_CONSOLE
	bool "Console on Parrot5/5+ serial port"
	depends on SERIAL_PARROT5
	select SERIAL_CORE_CONSOLE
	help
	  Select this option if you want to use one of the Parrot5/5+ serial ports
	  as console.

config SERIAL_PARROT5_SNOOP
	bool "Enable pattern matching on Parrot5/5+ serial port data"
	default n
	depends on SERIAL_PARROT5
	help
	  Select this option if you need to extract a pattern from serial port
	  data. This can be used to trigger actions with a low latency.

if SERIAL_PARROT5_SNOOP
config SERIAL_PARROT5_SNOOP_FILTER_PERIOD
	int "Matched pattern filtering period in milliseconds"
	range 0 1000
	default 0
	help
	  When this value is strictly positive, the snooping pattern is assumed
	  to repeat itself sequentially. Matched patterns are decimated (not
	  propagated to userland) so that they are spaced in time by at least
	  this period; they are still available as matched data.
endif # SERIAL_PARROT5_SNOOP

config SERIAL_DCC
	bool "JTAG ICE/ICD DCC serial port emulation support"
	depends on ARM
	select SERIAL_CORE
	help
	  This selects serial port emulation driver for ICE/ICD JTAG debugger
	  (e.g. Trace32) for ARM architecture. You should make an terminal with
	  DCC(JTAG1) protocol.

	  if unsure, say N.

config SERIAL_DCC_IDLE_POLL
	bool "Poll dcc io"
	depends on SERIAL_DCC
	help
		Improve dcc speed on cpu with dcc irq

config SERIAL_DCC_CONSOLE
	bool "Support for console on JTAG ICE/ICD DCC"
	depends on SERIAL_DCC
	select SERIAL_CORE_CONSOLE
	help
	  Say Y here if you wish to use ICE/ICD JTAG DCC serial port emulation
	  as the system console.

	  if unsure, say N.

config SERIAL_DCC_STDSERIAL
	bool "Install JTAG ICE/ICD DCC as standard serial"
	default y
	depends on !SERIAL_8250 && SERIAL_DCC
	help
	  Say Y here if you want to install DCC driver as a normal serial port
	  /dev/ttyS0 (major 4, minor 64). Otherwise, it appears as /dev/ttyJ0
	  (major 204, minor 186) and can co-exist with other UARTs, such as
	  8250/16C550 compatibles.

config SERIAL_MAX3100_P6
	tristate "MAX3100_P6 support"
	depends on SPI
	select SERIAL_CORE
	help
	  MAX3100 chip support with embeded P6/P6i SPI tweak
```

## sources/linux-2.6.36/linux-2.6.36/drivers/staging/ulogger/Kconfig
```kconfig
config ULOGGER
	boolean "Ulogger, a fork of Android Logger with a few additional features"
	default n

if ULOGGER
config ULOGGER_BUF_SHIFT
	int "Ulogger static log buffer size (16 => 64KB, 17 => 128KB)"
	range 16 20
	default 17
	help
	  Select ulogger static log (ulog_main) buffer size as a power of 2.
	  Examples:
		     17 => 128 KB
		     16 => 64 KB
	             15 => 32 KB
	             14 => 16 KB
		     13 =>  8 KB
		     12 =>  4 KB
endif # ULOGGER
```

## sources/linux-unknown/linux-unknown/arch/arm/mach-parrot6/Kconfig
```kconfig
menu "Parrot6 machines"
	depends on ARCH_PARROT6

config ARCH_VARIANT_PARROT6
	bool
	default n

config ARCH_VARIANT_PARROT6I
	bool
	default n

config MACH_PARROT_P6DEV
	bool "Parrot6 devboard"
	select ARCH_VARIANT_PARROT6
	default y
	help
		Say Y here if you are using a P6dev board.

config MACH_PARROT_PARELIA
	bool "Parrot parelia"
	select ARCH_VARIANT_PARROT6
	default n
	help
		Say Y here if you are using a parelia board.

config MACH_PARROT_OKIA
	bool "Parrot okia"
	select MACH_PARROT_PARELIA
	default n
	help
		Say Y here if you are using a okia board.

config MACH_PARROT_RNB4
	bool "Parrot RnB4"
	select ARCH_VARIANT_PARROT6
	default n
	help
		Say Y here if you are using a RnB4 board.

config MACH_PARROT_MKI2
	bool "Parrot Mki2"
	select ARCH_VARIANT_PARROT6
	default n
	help
		Say Y here if you are using a MKI2 board.

config MACH_PARROT_MYKONOS
	bool "Parrot mykonos"
	select ARCH_VARIANT_PARROT6
	default n
	help
		Say Y here if you are using a Mykonos board.

config MACH_PARROT_FC6XXX
	bool "Parrot FC6xxx"
	select ARCH_VARIANT_PARROT6
	default n
	help
		Say Y here if you are using a FC6xxx board.

config MACH_PARROT_P6IDEV
	bool "Parrot6i devboard"
	select ARCH_VARIANT_PARROT6I
	default n
	help
		Say Y here if you are using a P6idev board.

config MACH_PARROT_SIP6DEV
	bool "Parrot6i sip6 devboard"
	select ARCH_VARIANT_PARROT6I
	default n
	help
		Say Y here if you are using a SiP6dev board.

config MACH_PARROT_FC6050
	bool "Parrot FC6050W"
	select ARCH_VARIANT_PARROT6I
	default n
	help
		Say Y here if you are using a FC6050 board.

config MACH_PARROT_FC6050B
	bool "Parrot FC6050B"
	select ARCH_VARIANT_PARROT6I
	default n
	help
		Say Y here if you are using a FC6050 board.

config MACH_PARROT_DT1310
	bool "Parrot dt1310"
	select ARCH_VARIANT_PARROT6I
	default n
	help
		Say Y here if you are using a dt1310 board.

config MACH_PARROT_JPSUMO
	bool "Parrot jumping sumo"
	select ARCH_VARIANT_PARROT6I
	select WIRELESS_EXT     # needed for Broadcom BCM43526 driver
	select WEXT_PRIV
	select WEXT_SPY
	default n
	help
		Say Y here if you are using a jumping sumo board.

config MACH_PARROT_JPSUMO_EVO
	bool "Parrot jumping sumo EVO"
	select ARCH_VARIANT_PARROT6I
	select MACH_PARROT_JPSUMO
	default n
	help
		Say Y here if you are using a jumping sumo EVO board.

config MACH_PARROT_JPSUMO3
	bool "Parrot jumping sumo3"
	select ARCH_VARIANT_PARROT6I
	select MACH_PARROT_JPSUMO
	default n
	help
		Say Y here if you are using a jumping sumo 3 board.

config MACH_PARROT_DELOS
	bool "Parrot delos"
	select ARCH_VARIANT_PARROT6I
	default n
	help
		Say Y here if you are using a delos board.

config MACH_PARROT_DELOS_EVO
	bool "Parrot delos EVO"
	select ARCH_VARIANT_PARROT6I
	select MACH_PARROT_DELOS
	default n
	help
		Say Y here if you are using a delos EVO board.

config MACH_PARROT_DELOS3
	bool "Parrot delos3"
	select ARCH_VARIANT_PARROT6I
	select MACH_PARROT_DELOS
	default n
	help
		Say Y here if you are using a delos3  board.

config MACH_PARROT_WINGX
	bool "Parrot WingX"
	select ARCH_VARIANT_PARROT6I
	select MACH_PARROT_DELOS
	default n
	help
		Say Y here if you are using a WingX  board.

config MACH_PARROT_POWERUP
	bool "Parrot PowerUp"
	select ARCH_VARIANT_PARROT6I
	default n
	help
		Say Y here if you are using a PowerUp board.

config MACH_PARROT_FC6000P
	bool "Parrot FC6000P"
	select ARCH_VARIANT_PARROT6I
	default n
	help
		Say Y here if you are using a FC6000P board.


endmenu
```

## sources/linux-unknown/linux-unknown/arch/arm/plat-parrot/Kconfig
```kconfig
if ARCH_PARROT

choice
	prompt "Parrot ASIC generation"
	default ARCH_PARROT5

config ARCH_PARROT5
	bool "Parrot5/5+"

config ARCH_PARROT6
	select ARCH_WANT_OPTIONAL_GPIOLIB
	bool "Parrot6"

endchoice

config ARCH_PARROT_HR_TIMER
	bool "use new timer (p5+/p6)"
	default y
	select GENERIC_TIME
	select GENERIC_CLOCKEVENTS
	help
		This enable clockevent stuff

config ARCH_PARROT_USE_ROTATOR
	bool
# "Enable rotator IP for one rotator"
	help
		This will reserve the 2 first gpio irq needed to be able to use the rotator IP
	default n

config DEBUG_PARROT_UART_DEBUG_UNCOMPRESS
	bool "debug message during uncompress"
	default n

config DEBUG_PARROT_UART
	int "low level debug uart number"
	default 0
	depends on DEBUG_LL || DEBUG_PARROT_UART_DEBUG_UNCOMPRESS
	range 0 2 if ARCH_PARROT5
	range 0 3 if ARCH_PARROT6
	help
		Choose the uart that will print low level debug trace
	

config OPROFILE_PARROT
	bool "HR oprofile(p5+)"
	default n
	depends on OPROFILE
	depends on ARCH_PARROT5 || ARCH_PARROT6
	help
		This allow to get a more accurate profiling, but will be more
		intrusive.

config OPROFILE_PARROT_HZ
	int "profiling freq (in HZ)"
	range 100 50000
	default 10000
	depends on OPROFILE_PARROT

endif
#put it outside in order it can be seen on versatile
source "drivers/parrot/Kconfig"
```

## sources/linux-unknown/linux-unknown/drivers/parrot/Kconfig
```kconfig
if ARCH_PARROT || ARCH_VERSATILE

menu "Parrot drivers"
source "drivers/parrot/serial/Kconfig"
source "drivers/parrot/nand/Kconfig"
source "drivers/parrot/video/Kconfig"
source "drivers/parrot/i2c/Kconfig"
source "drivers/parrot/p264/Kconfig"
source "drivers/parrot/sound/p5p_aai/Kconfig"
source "drivers/parrot/sound/p6_aai/Kconfig"
source "drivers/parrot/power/Kconfig"
source "drivers/parrot/spi/Kconfig"
source "drivers/parrot/net/Kconfig"
source "drivers/parrot/mmc/Kconfig"
source "drivers/parrot/media/video/Kconfig"
source "drivers/parrot/input/Kconfig"
source "drivers/parrot/char/Kconfig"
source "drivers/parrot/usb/serial/blackberry/Kconfig"
source "drivers/parrot/ultra_sound/Kconfig"
source "drivers/parrot/misc/Kconfig"
source "drivers/parrot/pressure/Kconfig"
endmenu

endif
```

## sources/linux-unknown/linux-unknown/drivers/parrot/media/video/Kconfig
```kconfig
config CAMERA_PARROT
	tristate "PARROT Camera Interface driver"
	depends on VIDEO_DEV && HAS_DMA && (ARCH_PARROT6 || VERSATILE_PARROT6)
	select SOC_CAMERA
	select VIDEOBUF_DMA_CONTIG
	---help---
	  This is a v4l2 driver for the parrot6 Interface

config PARROT6_CAMIF_CACHED
	bool "cached buffer"
	depends on CAMERA_PARROT
	---help---
	This will make v4l2 buffer cached. You need to invalidate buffer, before
	sending back to buffer queue.
	Say n unless you know what you are doing.
```

## sources/linux-unknown/linux-unknown/drivers/parrot/mmc/Kconfig
```kconfig
config MMC_PARROT6
    tristate "Parrot6 SDHCI driver"
    	depends on ARM && MMC && MMC_SDHCI && (ARCH_PARROT6 || VERSATILE_PARROT6)
	help
	Parrot6 Arasan SDHCI driver support
```

## sources/linux-unknown/linux-unknown/drivers/parrot/nand/Kconfig
```kconfig
config MTD_NAND_PARROT_ECC
	bool "NAND PARROT ECC support"
	depends on MTD_NAND
	help
	  Use NAND parrot ecc with optimised assembly version for arm.

config MTD_NAND_P5P
	tristate "NAND support for P5P"
	depends on MTD_NAND && MACH_PARROT_P5
	help
	 Use NAND flash attached to the P5P

config MTD_NAND_ONFI
	tristate "ONFI compliant NAND support"
	depends on MTD_NAND
    select CRC16
	help
	 Enable support for ONFI compliant NAND devices configuration.

config MTD_PARROT_PARTS
	bool "Parrot command line partition table parsing"
	depends on MTD_PARTITIONS = "y" && MTD = "y"
	---help---
	  Allow generic configuration of the MTD partition tables via the kernel
	  command line. Multiple flash resources are supported for hardware where
	  different kinds of flash memory are available.

	  You will still need the parsing functions to be called by the driver
	  for your particular device. It won't happen automatically.

config MTD_NAND_BA315
	tristate "NAND support for Barco-Silex BA315"
	depends on MTD_NAND && (ARCH_PARROT6 || VERSATILE_PARROT6)
    select P6_NANDMC
    select MTD_NAND_ONFI
    select MTD_PARROT_PARTS
	help
	 Use NAND flash attached to the P6

config MTD_TESTS
	tristate "MTD tests support"
	depends on m
	help
	  This option includes various MTD tests into compilation. The tests
	  should normally be compiled as kernel modules. The modules perform
	  various checks and verifications when loaded.
```

## sources/linux-unknown/linux-unknown/drivers/parrot/net/wireless/88w8688/Kconfig
```kconfig
menuconfig 88W8688
        tristate "Marvell 88W8688 wireless driver over SDIO"
	depends on MMC
        default n
        help
          If you have a Marvel chip on your board you should say Y.

if 88W8688
source "drivers/parrot/net/wireless/88w8688/wlan/Kconfig"
source "drivers/parrot/net/wireless/88w8688/bt/Kconfig"
endif
```

## sources/linux-unknown/linux-unknown/drivers/parrot/net/wireless/88w8688/wlan/Kconfig
```kconfig
config 88W8688_WLAN
	tristate "88W8688 Wireless driver"
	depends on 88W8688 && WIRELESS
	select WIRELESS_EXT
	select WEXT_PRIV
	select WEXT_SPY
	help
		Marvell Wireless driver

config 88W8688_WLAN_DEBUG
	bool "88W8688 debugging"
	depends on 88W8688_WLAN != n
	default n
	help
	  This is an option for use by developers; most people should
	  say N here.  This enables driver debugging.

config 88W8688_WLAN_PROC_DEBUG
	bool "proc debug"
	depends on 88W8688_WLAN != n && PROC_FS
	default y

config 88W8688_WLAN_MFG_CMD_SUPPORT
	bool "Manufacturing firmware support"
	depends on 88W8688_WLAN != n
	default y

config 88W8688_WLAN_REASSOCIATION
	bool "Re-association in driver"
	depends on 88W8688_WLAN != n
	default y
```
