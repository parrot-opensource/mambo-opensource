## sources/linux-unknown/linux-unknown/drivers/parrot/net/wireless/Kconfig
```kconfig
source "drivers/parrot/net/wireless/ar6000/Kconfig"
source "drivers/parrot/net/wireless/88w8688/Kconfig"
```

## sources/linux-unknown/linux-unknown/drivers/parrot/net/wireless/ar6000/Kconfig
```kconfig
config AR6000_WLAN
        tristate "AR6000 wireless networking over SDIO"
	depends on MMC
        select WIRELESS_EXT
        default n
        help
          good luck.
```

## sources/linux-unknown/linux-unknown/drivers/parrot/power/Kconfig
```kconfig
config ACPOWER_PARROT
    tristate "PARROT AC power driver"
	depends on ARM && (ARCH_PARROT || ARCH_PARROT6 || VERSATILE_PARROT6)
	select POWER_SUPPLY
	help
        This is a simple power supply driver for targets having no battery.
		Select Parrot AC power supply driver.  
```

## sources/linux-unknown/linux-unknown/drivers/parrot/sound/p5p_aai/Kconfig
```kconfig
config AAI_PARROT5P
	tristate "Parrot5+ AAI"
	depends on SND
	depends on ARCH_PARROT5
	select SND_PCM
	select SND_HWDEP

config AAI_PARROT5P_DEBUG
	bool  "activate debug messages"
	default n
	depends on AAI_PARROT5P
```

## sources/linux-unknown/linux-unknown/drivers/parrot/sound/p6_aai/Kconfig
```kconfig
config AAI_PARROT6
	tristate "Parrot6 AAI"
	depends on SND
	depends on ARCH_PARROT6
	select SND_PCM
	select SND_HWDEP
    select SND_DYNAMIC_MINORS
    help
        Parrot6 AAI Driver.
        The driver uses ARM fast interrupts.
        For this reason it has to be statically linked, and not embedded as a kernel object.

config AAI_PARROT6_DEBUG
	bool  "compile with -O0 option"
	default n
	depends on AAI_PARROT6

config AAI_DBG_LEVEL
	int  "activate debug messages"
	default 0
	depends on AAI_PARROT6
   help
      level 0 : no messages
      level 1 : print importants, warning and error messages
      level 2 : add info messages
      level 3 : full verbose mode

config AAI_IRQ_SHARED
    bool
    default n
```

## sources/linux-unknown/linux-unknown/drivers/parrot/spi/Kconfig
```kconfig
config SPI_PARROT6
    tristate "Parrot6 SPI master driver"
	depends on ARM && SPI && (ARCH_PARROT6 || VERSATILE_PARROT6)
	help
        Select Parrot6 SPI master driver.

config SPI_MCU_MINIDRONES3
    tristate "Parrot6 minidrones3 MCU SPI driver"
	depends on SPI_PARROT6
	help
        Select Parrot6 minidrones3 MCU SPI driver.
```
